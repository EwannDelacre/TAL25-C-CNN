## CMakeLists.txt
```
cmake_minimum_required(VERSION 3.20.0)
find_package(Zephyr REQUIRED HINTS $ENV{ZEPHYR_BASE})
project(tflm_classifier)

target_sources(app PRIVATE src/main.c src/infer.cpp src/model_data.cc)
```

## prj.conf
```kconfig
CONFIG_MAIN_STACK_SIZE=4096
CONFIG_NEWLIB_LIBC=y
CONFIG_STDOUT_CONSOLE=y
CONFIG_CPP=y
CONFIG_CPLUSPLUS=y
CONFIG_EXCEPTIONS=n
```

## src/main.c
```c
//#include <zephyr/kernel.h>
#include <stdio.h>
#include "infer.h"

void main(void) {
    // data exemple
    float input[4] = {1.0f, 2.0f, 3.0f, 4.0f};
    float output[3] = {0};

    // init du modèle
    setup_model();

    // lancement inférence
    run_inference(input, 4, output, 3);

    printf("Résultat : %.3f %.3f %.3f\n", output[0], output[1], output[2]);
}
```

## src/infer.cpp
```c
#include "infer.h"
#include "model_data.h"  // tableau modèle

#include "tensorflow/lite/micro/micro_mutable_op_resolver.h"
#include "tensorflow/lite/micro/system_setup.h"
#include "tensorflow/lite/micro/micro_interpreter.h"
#include "tensorflow/lite/schema/schema_generated.h"

// taille de l'arène mémoire des tenseurs
#define TENSOR_ARENA_SIZE 4096
static uint8_t tensor_arena[TENSOR_ARENA_SIZE];

// objets TensorFlow
static tflite::MicroInterpreter* interpreter = nullptr;
static TfLiteTensor* input = nullptr;
static TfLiteTensor* output = nullptr;

void setup_model() {
    // initialisation plateforme (souvent vide en POSIX)
    tflite::InitializeTarget();

    // conversion du tableau modèle
    const tflite::Model* model = tflite::GetModel(g_model);

    // verif compatibilité
    if (model->version() != TFLITE_SCHEMA_VERSION) {
        printf("Erreur : version du modèle incompatible.\n");
        return;
    }

    // enregistrement opérations
    static tflite::MicroMutableOpResolver<4> resolver;
    resolver.AddFullyConnected();
    resolver.AddRelu();
    resolver.AddSoftmax();
    resolver.AddReshape();

    // création interpréteur
    static tflite::MicroInterpreter static_interpreter(
        model, resolver, tensor_arena, TENSOR_ARENA_SIZE);
    interpreter = &static_interpreter;

    // allocation mémoire et recup tenseurs d'E/S
    if (interpreter->AllocateTensors() != kTfLiteOk) {
        printf("Erreur lors de l'allocation des tenseurs.\n");
        return;
    }

    input = interpreter->input(0);
    output = interpreter->output(0);
}

// lancement inférence
// input > modèle > output
void run_inference(const float *input_data, int input_size, float *output_data, int output_size) {

  // input
    for (int i = 0; i < input_size; ++i) {
        input->data.f[i] = input_data[i];
    }

    // invocation modèle d'inférence
    if (interpreter->Invoke() != kTfLiteOk) {
        printf("Erreur : échec de l'inférence.\n");
        return;
    }

    // copie output
    for (int i = 0; i < output_size; ++i) {
        output_data[i] = output->data.f[i];
    }
}
```

## src/infer.h
```c
#ifndef INFER_H
#define INFER_H

#ifdef __cplusplus
extern "C" {
#endif

void setup_model(void);
void run_inference(const float *input, int input_size, float *output, int output_size);

#ifdef __cplusplus
}
#endif

#endif // INFER_H
```

## src/model_data.cc
```c
const unsigned char model_tflite[] = {
  0x63, 0x6f, 0x6e, 0x76, 0x65, 0x72, 0x74, 0x65, 0x72, 0x20, 0x3d, 0x20,
  0x74, 0x66, 0x2e, 0x6c, 0x69, 0x74, 0x65, 0x2e, 0x54, 0x46, 0x4c, 0x69,
  0x74, 0x65, 0x43, 0x6f, 0x6e, 0x76, 0x65, 0x72, 0x74, 0x65, 0x72, 0x2e,
  0x66, 0x72, 0x6f, 0x6d, 0x5f, 0x6b, 0x65, 0x72, 0x61, 0x73, 0x5f, 0x6d,
  0x6f, 0x64, 0x65, 0x6c, 0x28, 0x6d, 0x6f, 0x64, 0x65, 0x6c, 0x29, 0x0a,
  0x77, 0x69, 0x74, 0x68, 0x20, 0x6f, 0x70, 0x65, 0x6e, 0x28, 0x22, 0x6d,
  0x6f, 0x64, 0x65, 0x6c, 0x2e, 0x74, 0x66, 0x6c, 0x69, 0x74, 0x65, 0x22,
  0x2c, 0x20, 0x22, 0x77, 0x62, 0x22, 0x29, 0x20, 0x61, 0x73, 0x20, 0x66,
  0x3a, 0x0a, 0x20, 0x20, 0x20, 0x20, 0x66, 0x2e, 0x77, 0x72, 0x69, 0x74,
  0x65, 0x28, 0x63, 0x6f, 0x6e, 0x76, 0x65, 0x72, 0x74, 0x65, 0x72, 0x2e,
  0x63, 0x6f, 0x6e, 0x76, 0x65, 0x72, 0x74, 0x28, 0x29, 0x29, 0x0a
};
const unsigned int model_tflite_len = 131;
```

## src/model_data.h
```c
#ifndef MODEL_DATA_H
#define MODEL_DATA_H

#ifdef __cplusplus
extern "C" {
#endif

extern const unsigned char g_model[];
extern const int g_model_len;

#ifdef __cplusplus
}
#endif

#endif // MODEL_DATA_H
```
